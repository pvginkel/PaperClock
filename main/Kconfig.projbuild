## main/Kconfig.projbuild
```kconfig
menu "Device Configuration"

    orsource "$IDF_PATH/examples/common_components/env_caps/$IDF_TARGET/Kconfig.env_caps"

    config DEVICE_RESTART_ON_FAILURE_INTERVAL
        int "Timeout after which the device restarts when on the error screen in seconds"
        default 300

endmenu

menu "Display Configuration"
    config DISPLAY_DOUBLE_FB
        bool "Use double Frame Buffer"
        default "n"
        help
            Enable this option, driver will allocate two frame buffers.

    config DISPLAY_USE_BOUNCE_BUFFER
        depends on !DISPLAY_DOUBLE_FB
        bool "Use bounce buffer"
        help
            Enable bounce buffer mode can achieve higher PCLK frequency at the cost of higher CPU consumption.

    config DISPLAY_AVOID_TEAR_EFFECT_WITH_SEM
        depends on !DISPLAY_DOUBLE_FB
        bool "Avoid tearing effect"
        default "y"
        help
            Enable this option, the example will use a pair of semaphores to avoid the tearing effect.
            Note, if the Double Frame Buffer is used, then we can also avoid the tearing effect without the lock.

    config DISPLAY_PIN_MOSI
        int "MOSI GPIO number"
        default 15 if IDF_TARGET_ESP32
        default 35 if IDF_TARGET_ESP32S2
        default 11 if IDF_TARGET_ESP32S3
        default 5  if IDF_TARGET_ESP32H2
        default 4  # C3 and others

    config DISPLAY_PIN_MISO
        int "MISO GPIO number"
        default 2 if IDF_TARGET_ESP32
        default 37 if IDF_TARGET_ESP32S2
        default 13 if IDF_TARGET_ESP32S3
        default 0  if IDF_TARGET_ESP32H2
        default 6  # C3 and others

    config DISPLAY_PIN_CLK
        int "CLK GPIO number"
        default 14 if IDF_TARGET_ESP32
        default 36 if IDF_TARGET_ESP32S2
        default 12 if IDF_TARGET_ESP32S3
        default 4  if IDF_TARGET_ESP32H2
        default 5  # C3 and others

    config DISPLAY_PIN_CS
        int "CS GPIO number"
        default 13 if IDF_TARGET_ESP32
        default 34 if IDF_TARGET_ESP32S2
        default -1 if IDF_TARGET_ESP32S3
        default 1  # C3 and others

    config DISPLAY_AUTO_OFF_MS
        int "Turn off display after ms"
        default 0
        
endmenu
```

## sdkconfig.defaults
```kconfig
# Application configuration

CONFIG_DISPLAY_AUTO_OFF_MS=20000
CONFIG_DISPLAY_DOUBLE_FB=y

CONFIG_MQTT_PROTOCOL_5=y

CONFIG_ESP_MAIN_TASK_STACK_SIZE=6144

# IT8951

CONFIG_IT8951_CS_PIN=10
CONFIG_IT8951_DISPLAY_READY_PIN=8
CONFIG_IT8951_MISO_PIN=13
CONFIG_IT8951_MOSI_PIN=11
CONFIG_IT8951_RESET_PIN=9
CONFIG_IT8951_SCLK_PIN=12
CONFIG_IT8951_SPI_BUS_SPEED_DIVIDER=7
CONFIG_IT8951_SPI_HOST=2

# LVGL

CONFIG_LV_ASSERT_HANDLER_INCLUDE="../../../../main/lvgl_assert.h"
CONFIG_LV_COLOR_DEPTH_1=y
CONFIG_LV_COLOR_DEPTH=1
CONFIG_LV_CONF_MINIMAL=y
CONFIG_LV_DPI_DEF=220
CONFIG_LV_FONT_DEFAULT_MONTSERRAT_8=y
CONFIG_LV_FONT_MONTSERRAT_8=y
CONFIG_LV_LOG_LEVEL_WARN=y
CONFIG_LV_LOG_LEVEL=2
CONFIG_LV_LOG_PRINTF=y
CONFIG_LV_LOG_TRACE_ANIM=y
CONFIG_LV_LOG_TRACE_CACHE=y
CONFIG_LV_LOG_TRACE_DISP_REFR=y
CONFIG_LV_LOG_TRACE_EVENT=y
CONFIG_LV_LOG_TRACE_INDEV=y
CONFIG_LV_LOG_TRACE_LAYOUT=y
CONFIG_LV_LOG_TRACE_MEM=y
CONFIG_LV_LOG_TRACE_OBJ_CREATE=y
CONFIG_LV_LOG_TRACE_TIMER=y
CONFIG_LV_LOG_USE_FILE_LINE=y
CONFIG_LV_LOG_USE_TIMESTAMP=y
CONFIG_LV_THEME_DEFAULT_TRANSITION_TIME=0
CONFIG_LV_TXT_BREAK_CHARS=" "
CONFIG_LV_USE_ASSERT_STYLE=y
CONFIG_LV_USE_CLIB_MALLOC=y
CONFIG_LV_USE_CLIB_SPRINTF=y
CONFIG_LV_USE_CLIB_STRING=y
CONFIG_LV_USE_LOG=y
CONFIG_LV_USE_TINY_TTF=y
CONFIG_LV_THEME_DEFAULT_TRANSITION_TIME=0
CONFIG_LV_TXT_ENC_UTF8=y
CONFIG_LV_USE_ASSERT_MALLOC=y
CONFIG_LV_USE_ASSERT_NULL=y
CONFIG_LV_USE_FLEX=y
CONFIG_LV_USE_GRID=y
CONFIG_LV_USE_LABEL=y
CONFIG_LV_USE_THEME_DEFAULT=y

# Setup flash

CONFIG_ESPTOOLPY_FLASHSIZE_8MB=y
CONFIG_PARTITION_TABLE_CUSTOM=y

# SPIRAM

CONFIG_SPIRAM=y
CONFIG_SPIRAM_FETCH_INSTRUCTIONS=y
CONFIG_SPIRAM_RODATA=y
CONFIG_SPIRAM_SPEED_80M=y
CONFIG_SPIRAM_TRY_ALLOCATE_WIFI_LWIP=y

# Required for WiFI

CONFIG_DIAG_USE_EXTERNAL_LOG_WRAP=y

# MQTT

CONFIG_MQTT_TOPIC_PREFIX="pieter"
CONFIG_MQTT_DEVICE_MANUFACTURER="Pieter"
CONFIG_MQTT_DEVICE_MODEL="Paper Clock"
CONFIG_MQTT_DEVICE_MODEL_ID="Paper Clock v1"
```
